## boards/shields/genesis_source/Kconfig.defconfig
```kconfig
if SHIELD_GENESIS_SOURCE_LEFT

config ZMK_KEYBOARD_NAME
    default "GENESIS_SOURCE"

config ZMK_SPLIT_ROLE_CENTRAL
    default y

endif # SHIELD_GENESIS_SOURCE_LEFT

if SHIELD_GENESIS_SOURCE_LEFT || SHIELD_GENESIS_SOURCE_RIGHT

config ZMK_SPLIT
    default y

endif # SHIELD_GENESIS_SOURCE_LEFT || SHIELD_GENESIS_SOURCE_RIGHT
```
